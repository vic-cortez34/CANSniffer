VERSION ""

NS_ :

BS_:

BU_:

BO_ 2564485397 WWHOBD: 8 Vector__XXX
 SG_ S M : 15|8@0+ (1,0) [0|15] "" Vector__XXX
 SG_ S22F4PID m66M : 31|8@0+ (1,0) [0|255] "" Vector__XXX
 SG_ S22F4PID00_PIDsSupported_01_20 m0 : 39|32@0+ (1,0) [0|4294967295] "" Vector__XXX
 SG_ S22F4PID01_MonitorStatus m1 : 39|32@0+ (1,0) [0|4294967295] "" Vector__XXX
 SG_ S22F4PID03_FuelSystemStatus m3 : 39|16@0+ (1,0) [0|65535] "" Vector__XXX
 SG_ S22F4PID04_CalcEngineLoad m4 : 39|8@0+ (0.39216,0) [0|100] "%" Vector__XXX
 SG_ S22F4PID05_EngineCoolantTemp m5 : 39|8@0+ (1,-40) [-40|215] "degC" Vector__XXX
 SG_ S22F4PID06_ShortFuelTrimBank1 m6 : 39|8@0+ (0.78125,-100) [-100|99.21875] "%" Vector__XXX
 SG_ S22F4PID07_LongFuelTrimBank1 m7 : 39|8@0+ (0.78125,-100) [-100|99.21875] "%" Vector__XXX
 SG_ S22F4PID08_ShortFuelTrimBank2 m8 : 39|8@0+ (0.78125,-100) [-100|99.21875] "%" Vector__XXX
 SG_ S22F4PID09_LongFuelTrimBank2 m9 : 39|8@0+ (0.78125,-100) [-100|99.21875] "%" Vector__XXX
 SG_ S22F4PID0A_FuelPressure m10 : 39|8@0+ (3,0) [0|765] "kPa" Vector__XXX
 SG_ S22F4PID0B_IntakeManiAbsPress m11 : 39|8@0+ (1,0) [0|255] "kPa" Vector__XXX
 SG_ S22F4PID0C_EngineRPM m12 : 39|16@0+ (0.25,0) [0|16383.75] "rpm" Vector__XXX
 SG_ S22F4PID0D_VehicleSpeed m13 : 39|8@0+ (1,0) [0|255] "km/h" Vector__XXX
 SG_ S22F4PID0E_TimingAdvance m14 : 39|8@0+ (0.5,-64) [-64|63.5] "deg before TDC" Vector__XXX
 SG_ S22F4PID0F_IntakeAirTemperature m15 : 39|8@0+ (1,-40) [-40|215] "degC" Vector__XXX
 SG_ S22F4PID10_MAFAirFlowRate m16 : 39|16@0+ (0.01,0) [0|655.35] "grams/sec" Vector__XXX
 SG_ S22F4PID11_ThrottlePosition m17 : 39|8@0+ (0.39216,0) [0|100] "%" Vector__XXX
 SG_ S22F4PID12_CmdSecAirStatus m18 : 39|8@0+ (1,0) [0|255] "" Vector__XXX
 SG_ S22F4PID14_OxySensor1_STFT m20 : 47|8@0+ (0.78125,-100) [-100|99.21875] "%" Vector__XXX
 SG_ S22F4PID14_OxySensor1_Volt m20 : 39|8@0+ (0.005,0) [0|1.275] "volts" Vector__XXX
 SG_ S22F4PID15_OxySensor2_STFT m21 : 47|8@0+ (0.78125,-100) [-100|99.21875] "%" Vector__XXX
 SG_ S22F4PID15_OxySensor2_Volt m21 : 39|8@0+ (0.005,0) [0|1.275] "volts" Vector__XXX
 SG_ S22F4PID16_OxySensor3_STFT m22 : 47|8@0+ (0.78125,-100) [-100|99.21875] "%" Vector__XXX
 SG_ S22F4PID16_OxySensor3_Volt m22 : 39|8@0+ (0.005,0) [0|1.275] "volts" Vector__XXX
 SG_ S22F4PID17_OxySensor4_STFT m23 : 47|8@0+ (0.78125,-100) [-100|99.21875] "%" Vector__XXX
 SG_ S22F4PID17_OxySensor4_Volt m23 : 39|8@0+ (0.005,0) [0|1.275] "volts" Vector__XXX
 SG_ S22F4PID18_OxySensor5_STFT m24 : 47|8@0+ (0.78125,-100) [-100|99.21875] "%" Vector__XXX
 SG_ S22F4PID18_OxySensor5_Volt m24 : 39|8@0+ (0.005,0) [0|1.275] "volts" Vector__XXX
 SG_ S22F4PID19_OxySensor6_STFT m25 : 47|8@0+ (0.78125,-100) [-100|99.21875] "%" Vector__XXX
 SG_ S22F4PID19_OxySensor6_Volt m25 : 39|8@0+ (0.005,0) [0|1.275] "volts" Vector__XXX
 SG_ S22F4PID1A_OxySensor7_STFT m26 : 47|8@0+ (0.78125,-100) [-100|99.21875] "%" Vector__XXX
 SG_ S22F4PID1A_OxySensor7_Volt m26 : 39|8@0+ (0.005,0) [0|1.275] "volts" Vector__XXX
 SG_ S22F4PID1B_OxySensor8_STFT m27 : 47|8@0+ (0.78125,-100) [-100|99.21875] "%" Vector__XXX
 SG_ S22F4PID1B_OxySensor8_Volt m27 : 39|8@0+ (0.005,0) [0|1.275] "volts" Vector__XXX
 SG_ S22F4PID1C_OBDStandard m28 : 39|8@0+ (1,0) [0|255] "" Vector__XXX
 SG_ S22F4PID1F_TimeSinceEngStart m31 : 39|16@0+ (1,0) [0|65535] "seconds" Vector__XXX
 SG_ S22F4PID20_PIDsSupported_21_40 m32 : 39|32@0+ (1,0) [0|4294967295] "" Vector__XXX
 SG_ S22F4PID21_DistanceMILOn m33 : 39|16@0+ (1,0) [0|65535] "km" Vector__XXX
 SG_ S22F4PID22_FuelRailPres m34 : 39|16@0+ (0.079,0) [0|5177.265] "kPa" Vector__XXX
 SG_ S22F4PID23_FuelRailGaug m35 : 39|16@0+ (10,0) [0|655350] "kPa" Vector__XXX
 SG_ S22F4PID24_OxySensor1_FAER m36 : 39|16@0+ (3.0517578125E-005,0) [0|2] "ratio" Vector__XXX
 SG_ S22F4PID24_OxySensor1_Volt m36 : 55|16@0+ (0.0001220703125,0) [0|2] "volts" Vector__XXX
 SG_ S22F4PID25_OxySensor2_FAER m37 : 39|16@0+ (3.0517578125E-005,0) [0|2] "ratio" Vector__XXX
 SG_ S22F4PID25_OxySensor2_Volt m37 : 55|16@0+ (0.0001220703125,0) [0|8] "volts" Vector__XXX
 SG_ S22F4PID26_OxySensor3_FAER m38 : 39|16@0+ (3.0517578125E-005,0) [0|2] "ratio" Vector__XXX
 SG_ S22F4PID26_OxySensor3_Volt m38 : 55|16@0+ (0.0001220703125,0) [0|8] "volts" Vector__XXX
 SG_ S22F4PID27_OxySensor4_FAER m39 : 39|16@0+ (3.0517578125E-005,0) [0|2] "ratio" Vector__XXX
 SG_ S22F4PID27_OxySensor4_Volt m39 : 55|16@0+ (0.0001220703125,0) [0|8] "volts" Vector__XXX
 SG_ S22F4PID28_OxySensor5_FAER m40 : 39|16@0+ (3.0517578125E-005,0) [0|2] "ratio" Vector__XXX
 SG_ S22F4PID28_OxySensor5_Volt m40 : 55|16@0+ (0.0001220703125,0) [0|8] "volts" Vector__XXX
 SG_ S22F4PID29_OxySensor6_FAER m41 : 39|16@0+ (3.0517578125E-005,0) [0|2] "ratio" Vector__XXX
 SG_ S22F4PID29_OxySensor6_Volt m41 : 55|16@0+ (0.0001220703125,0) [0|8] "volts" Vector__XXX
 SG_ S22F4PID2A_OxySensor7_FAER m42 : 39|16@0+ (3.0517578125E-005,0) [0|2] "ratio" Vector__XXX
 SG_ S22F4PID2A_OxySensor7_Volt m42 : 55|16@0+ (0.0001220703125,0) [0|8] "volts" Vector__XXX
 SG_ S22F4PID2B_OxySensor8_FAER m43 : 39|16@0+ (3.0517578125E-005,0) [0|2] "ratio" Vector__XXX
 SG_ S22F4PID2B_OxySensor8_Volt m43 : 55|16@0+ (0.0001220703125,0) [0|8] "volts" Vector__XXX
 SG_ S22F4PID2C_CmdEGR m44 : 39|8@0+ (0.392156862745098,0) [0|100] "%" Vector__XXX
 SG_ S22F4PID2D_EGRError m45 : 39|8@0+ (0.78125,-100) [-100|99.21875] "%" Vector__XXX
 SG_ S22F4PID2E_CmdEvapPurge m46 : 39|8@0+ (0.392156862745098,0) [0|100] "%" Vector__XXX
 SG_ S22F4PID2F_FuelTankLevel m47 : 39|8@0+ (0.392156862745098,0) [0|100] "%" Vector__XXX
 SG_ S22F4PID30_WarmUpsSinceCodeClear m48 : 39|8@0+ (1,0) [0|255] "count" Vector__XXX
 SG_ S22F4PID31_DistanceSinceCodeClear m49 : 39|16@0+ (1,0) [0|65535] "km" Vector__XXX
 SG_ S22F4PID32_EvapSysVaporPres m50 : 39|16@0+ (0.25,0) [-8192|8191.75] "Pa" Vector__XXX
 SG_ S22F4PID33_AbsBaroPres m51 : 39|8@0+ (1,0) [0|255] "kPa" Vector__XXX
 SG_ S22F4PID34_OxySensor1_Crnt m52 : 55|16@0+ (0.00390625,-128) [-128|128] "mA" Vector__XXX
 SG_ S22F4PID34_OxySensor1_FAER m52 : 39|16@0+ (3.0517578125E-005,0) [0|2] "ratio" Vector__XXX
 SG_ S22F4PID35_OxySensor2_Crnt m53 : 55|16@0+ (0.00390625,-128) [-128|128] "mA" Vector__XXX
 SG_ S22F4PID35_OxySensor2_FAER m53 : 39|16@0+ (3.0517578125E-005,0) [0|2] "ratio" Vector__XXX
 SG_ S22F4PID36_OxySensor3_Crnt m54 : 55|16@0+ (0.00390625,-128) [-128|128] "mA" Vector__XXX
 SG_ S22F4PID36_OxySensor3_FAER m54 : 39|16@0+ (3.0517578125E-005,0) [0|2] "ratio" Vector__XXX
 SG_ S22F4PID37_OxySensor4_Crnt m55 : 55|16@0+ (0.00390625,-128) [-128|128] "mA" Vector__XXX
 SG_ S22F4PID37_OxySensor4_FAER m55 : 39|16@0+ (3.0517578125E-005,0) [0|2] "ratio" Vector__XXX
 SG_ S22F4PID38_OxySensor5_Crnt m56 : 55|16@0+ (0.00390625,-128) [-128|128] "mA" Vector__XXX
 SG_ S22F4PID38_OxySensor5_FAER m56 : 39|16@0+ (3.0517578125E-005,0) [0|2] "ratio" Vector__XXX
 SG_ S22F4PID39_OxySensor6_Crnt m57 : 55|16@0+ (0.00390625,-128) [-128|128] "mA" Vector__XXX
 SG_ S22F4PID39_OxySensor6_FAER m57 : 39|16@0+ (3.0517578125E-005,0) [0|2] "ratio" Vector__XXX
 SG_ S22F4PID3A_OxySensor7_Crnt m58 : 55|16@0+ (0.00390625,-128) [-128|128] "mA" Vector__XXX
 SG_ S22F4PID3A_OxySensor7_FAER m58 : 39|16@0+ (3.0517578125E-005,0) [0|2] "ratio" Vector__XXX
 SG_ S22F4PID3B_OxySensor8_Crnt m59 : 55|16@0+ (0.00390625,-128) [-128|128] "mA" Vector__XXX
 SG_ S22F4PID3B_OxySensor8_FAER m59 : 39|16@0+ (3.0517578125E-005,0) [0|2] "ratio" Vector__XXX
 SG_ S22F4PID3C_CatTempBank1Sens1 m60 : 39|16@0+ (0.1,-40) [-40|6513.5] "degC" Vector__XXX
 SG_ S22F4PID3D_CatTempBank2Sens1 m61 : 39|16@0+ (0.1,-40) [-40|6513.5] "degC" Vector__XXX
 SG_ S22F4PID3E_CatTempBank1Sens2 m62 : 39|16@0+ (0.1,-40) [-40|6513.5] "degC" Vector__XXX
 SG_ S22F4PID3F_CatTempBank2Sens2 m63 : 39|16@0+ (0.1,-40) [-40|6513.5] "degC" Vector__XXX
 SG_ S22F4PID40_PIDsSupported_41_60 m64 : 39|32@0+ (1,0) [0|4294967295] "" Vector__XXX
 SG_ S22F4PID41_MonStatusDriveCycle m65 : 39|32@0+ (1,0) [0|4294967295] "" Vector__XXX
 SG_ S22F4PID42_ControlModuleVolt m66 : 39|16@0+ (0.001,0) [0|65.535] "V" Vector__XXX
 SG_ S22F4PID43_AbsLoadValue m67 : 39|16@0+ (0.392156862745098,0) [0|25700] "%" Vector__XXX
 SG_ S22F4PID44_FuelAirCmdEquiv m68 : 39|16@0+ (3.0517578125E-005,0) [0|2] "ratio" Vector__XXX
 SG_ S22F4PID45_RelThrottlePos m69 : 39|8@0+ (0.392156862745098,0) [0|100] "%" Vector__XXX
 SG_ S22F4PID46_AmbientAirTemp m70 : 39|8@0+ (1,-40) [-40|215] "degC" Vector__XXX
 SG_ S22F4PID47_AbsThrottlePosB m71 : 39|8@0+ (0.392156862745098,0) [0|100] "%" Vector__XXX
 SG_ S22F4PID48_AbsThrottlePosC m72 : 39|8@0+ (0.392156862745098,0) [0|100] "%" Vector__XXX
 SG_ S22F4PID49_AbsThrottlePosD m73 : 39|8@0+ (0.392156862745098,0) [0|100] "%" Vector__XXX
 SG_ S22F4PID4A_AbsThrottlePosE m74 : 39|8@0+ (0.392156862745098,0) [0|100] "%" Vector__XXX
 SG_ S22F4PID4B_AbsThrottlePosF m75 : 39|8@0+ (0.392156862745098,0) [0|100] "%" Vector__XXX
 SG_ S22F4PID4C_CmdThrottleAct m76 : 39|8@0+ (0.392156862745098,0) [0|100] "%" Vector__XXX
 SG_ S22F4PID4D_TimeRunMILOn m77 : 39|16@0+ (1,0) [0|65535] "minutes" Vector__XXX
 SG_ S22F4PID4E_TimeSinceCodeClear m78 : 39|16@0+ (1,0) [0|65535] "minutes" Vector__XXX
 SG_ S22F4PID4F_Max_FAER m79 : 39|8@0+ (1,0) [0|255] "ratio" Vector__XXX
 SG_ S22F4PID4F_Max_IntManiAbsPres m79 : 63|8@0+ (10,0) [0|2550] "kPa" Vector__XXX
 SG_ S22F4PID4F_Max_OxySensCrnt m79 : 55|8@0+ (1,0) [0|255] "mA" Vector__XXX
 SG_ S22F4PID4F_Max_OxySensVol m79 : 47|8@0+ (1,0) [0|255] "V" Vector__XXX
 SG_ S22F4PID50_Max_AirFlowMAF m80 : 39|8@0+ (10,0) [0|2550] "g/s" Vector__XXX
 SG_ S22F4PID51_FuelType m81 : 39|8@0+ (1,0) [0|255] "" Vector__XXX
 SG_ S22F4PID52_EthanolFuelPct m82 : 39|8@0+ (0.392156862745098,0) [0|100] "%" Vector__XXX
 SG_ S22F4PID53_AbsEvapSysVapPres m83 : 39|16@0+ (0.005,0) [0|327.675] "kPa" Vector__XXX
 SG_ S22F4PID54_EvapSysVapPres m84 : 39|16@0+ (1,-32767) [-32767|32768] "Pa" Vector__XXX
 SG_ S22F4PID55_ShortSecOxyTrimBank1 m85 : 39|8@0+ (0.78125,-100) [-100|99.21875] "%" Vector__XXX
 SG_ S22F4PID55_ShortSecOxyTrimBank3 m85 : 47|8@0+ (0.78125,-100) [-100|99.21875] "%" Vector__XXX
 SG_ S22F4PID56_LongSecOxyTrimBank1 m86 : 39|8@0+ (0.78125,-100) [-100|99.21875] "%" Vector__XXX
 SG_ S22F4PID56_LongSecOxyTrimBank3 m86 : 47|8@0+ (0.78125,-100) [-100|99.21875] "%" Vector__XXX
 SG_ S22F4PID57_ShortSecOxyTrimBank2 m87 : 39|8@0+ (0.78125,-100) [-100|99.21875] "%" Vector__XXX
 SG_ S22F4PID57_ShortSecOxyTrimBank4 m87 : 47|8@0+ (0.78125,-100) [-100|99.21875] "%" Vector__XXX
 SG_ S22F4PID58_LongSecOxyTrimBank2 m88 : 39|8@0+ (0.78125,-100) [-100|99.21875] "%" Vector__XXX
 SG_ S22F4PID58_LongSecOxyTrimBank4 m88 : 47|8@0+ (0.78125,-100) [-100|99.21875] "%" Vector__XXX
 SG_ S22F4PID59_FuelRailAbsPres m89 : 39|16@0+ (10,0) [0|655350] "kPa" Vector__XXX
 SG_ S22F4PID5A_RelAccelPedalPos m90 : 39|8@0+ (0.392156862745098,0) [0|100] "%" Vector__XXX
 SG_ S22F4PID5B_HybrBatPackRemLife m91 : 39|8@0+ (0.392156862745098,0) [0|100] "%" Vector__XXX
 SG_ S22F4PID5C_EngineOilTemp m92 : 39|8@0+ (1,-40) [-40|215] "degC" Vector__XXX
 SG_ S22F4PID5D_FuelInjectionTiming m93 : 39|16@0+ (0.0078125,-210) [-210|301.9921875] "deg" Vector__XXX
 SG_ S22F4PID5E_EngineFuelRate m94 : 39|16@0+ (0.05,0) [0|3276.75] "L/h" Vector__XXX
 SG_ S22F4PID5F_EmissionReq m95 : 39|8@0+ (1,0) [0|255] "" Vector__XXX
 SG_ S22F4PID60_PIDsSupported_61_80 m96 : 39|32@0+ (1,0) [0|4294967295] "" Vector__XXX
 SG_ S22F4PID61_DemandEngTorqPct m97 : 39|8@0+ (1,-125) [-125|130] "%" Vector__XXX
 SG_ S22F4PID62_ActualEngTorqPct m98 : 39|8@0+ (1,-125) [-125|130] "%" Vector__XXX
 SG_ S22F4PID63_EngRefTorq m99 : 39|16@0+ (1,0) [0|65535] "Nm" Vector__XXX
 SG_ S22F4PID65_AuxInputOutput m101 : 39|8@0+ (1,0) [0|255] "" Vector__XXX
 SG_ S22F4PID66_MAFSensor m102 : 39|8@0+ (1,0) [0|255] "" Vector__XXX
 SG_ S22F4PID67_EngineCoolantTemp m103 : 39|8@0+ (1,0) [0|255] "" Vector__XXX
 SG_ S22F4PID68_IntakeAirTempSens m104 : 39|8@0+ (1,0) [0|255] "" Vector__XXX
 SG_ S22F4PID69_CmdEGR_EGRError m105 : 39|8@0+ (1,0) [0|255] "" Vector__XXX
 SG_ S22F4PID6A_CmdDieselIntAir m106 : 39|8@0+ (1,0) [0|255] "" Vector__XXX
 SG_ S22F4PID6B_ExhaustGasTemp m107 : 39|8@0+ (1,0) [0|255] "" Vector__XXX
 SG_ S22F4PID6C_CmdThrottleActRel m108 : 39|8@0+ (1,0) [0|255] "" Vector__XXX
 SG_ S22F4PID6D_FuelPresContrSys m109 : 39|8@0+ (1,0) [0|255] "" Vector__XXX
 SG_ S22F4PID6E_InjPresContrSys m110 : 39|8@0+ (1,0) [0|255] "" Vector__XXX
 SG_ S22F4PID6F_TurboComprPres m111 : 39|8@0+ (1,0) [0|255] "" Vector__XXX
 SG_ S22F4PID70_BoostPresCntrl m112 : 39|8@0+ (1,0) [0|255] "" Vector__XXX
 SG_ S22F4PID80_PIDsSupported_81_A0 m128 : 39|32@0+ (1,0) [0|4294967295] "" Vector__XXX
 SG_ S22F4PID8E_EngFrictionPctTorq m142 : 39|8@0+ (1,-125) [-125|130] "%" Vector__XXX
 SG_ S22F4PIDA0_PIDsSupported_A1_C0 m160 : 39|32@0+ (1,0) [0|4294967295] "" Vector__XXX
 SG_ S22F4PIDA6_Odometer m166 : 39|32@0+ (0.1,0) [0|429496729.5] "km" Vector__XXX
 SG_ S22F4PIDC0_PIDsSupported_C1_E0 m192 : 39|32@0+ (1,0) [0|4294967295] "" Vector__XXX
 SG_ S22F8PID m66M : 31|8@0+ (1,0) [0|255] "" Vector__XXX
 SG_ SubFct m98M : 23|8@0+ (1,0) [0|255] "" Vector__XXX

CM_ BO_ 2564485397 "OBD";
BA_DEF_ SG_  "SignalIgnore" INT 0 1;
BA_DEF_ BO_  "VFrameFormat" ENUM  "StandardCAN","ExtendedCAN","StandardCAN_FD","ExtendedCAN_FD","J1939PG";
BA_DEF_ BO_  "TransportProtocolType" STRING ;
BA_DEF_  "BusType" STRING ;
BA_DEF_  "ProtocolType" STRING ;
BA_DEF_  "DatabaseCompiler" STRING ;
BA_DEF_DEF_  "SignalIgnore" 0;
BA_DEF_DEF_  "VFrameFormat" "";
BA_DEF_DEF_  "TransportProtocolType" "";
BA_DEF_DEF_  "BusType" "";
BA_DEF_DEF_  "ProtocolType" "";
BA_DEF_DEF_  "DatabaseCompiler" "CSS Electronics (wwww.csselectronics.com)";
BA_ "BusType" "CAN";
BA_ "ProtocolType" "J1939";
BA_ "VFrameFormat" BO_ 2564485397 4;

BA_ "SignalIgnore" SG_ 2564485397 S22F4PID 1;
BA_ "SignalIgnore" SG_ 2564485397 S22F8PID 1;
BA_ "SignalIgnore" SG_ 2564485397 S 1;
BA_ "SignalIgnore" SG_ 2564485397 SubFct 1;
BA_ "TransportProtocolType" BO_ 2564485397 "ISOTP";

SG_MUL_VAL_ 2564485397 S22F4PID SubFct 244-244;
SG_MUL_VAL_ 2564485397 S22F4PID00_PIDsSupported_01_20 S22F4PID 0-0;
SG_MUL_VAL_ 2564485397 S22F4PID01_MonitorStatus S22F4PID 1-1;
SG_MUL_VAL_ 2564485397 S22F4PID03_FuelSystemStatus S22F4PID 3-3;
SG_MUL_VAL_ 2564485397 S22F4PID04_CalcEngineLoad S22F4PID 4-4;
SG_MUL_VAL_ 2564485397 S22F4PID05_EngineCoolantTemp S22F4PID 5-5;
SG_MUL_VAL_ 2564485397 S22F4PID06_ShortFuelTrimBank1 S22F4PID 6-6;
SG_MUL_VAL_ 2564485397 S22F4PID07_LongFuelTrimBank1 S22F4PID 7-7;
SG_MUL_VAL_ 2564485397 S22F4PID08_ShortFuelTrimBank2 S22F4PID 8-8;
SG_MUL_VAL_ 2564485397 S22F4PID09_LongFuelTrimBank2 S22F4PID 9-9;
SG_MUL_VAL_ 2564485397 S22F4PID0A_FuelPressure S22F4PID 10-10;
SG_MUL_VAL_ 2564485397 S22F4PID0B_IntakeManiAbsPress S22F4PID 11-11;
SG_MUL_VAL_ 2564485397 S22F4PID0C_EngineRPM S22F4PID 12-12;
SG_MUL_VAL_ 2564485397 S22F4PID0D_VehicleSpeed S22F4PID 13-13;
SG_MUL_VAL_ 2564485397 S22F4PID0E_TimingAdvance S22F4PID 14-14;
SG_MUL_VAL_ 2564485397 S22F4PID0F_IntakeAirTemperature S22F4PID 15-15;
SG_MUL_VAL_ 2564485397 S22F4PID10_MAFAirFlowRate S22F4PID 16-16;
SG_MUL_VAL_ 2564485397 S22F4PID11_ThrottlePosition S22F4PID 17-17;
SG_MUL_VAL_ 2564485397 S22F4PID12_CmdSecAirStatus S22F4PID 18-18;
SG_MUL_VAL_ 2564485397 S22F4PID14_OxySensor1_STFT S22F4PID 20-20;
SG_MUL_VAL_ 2564485397 S22F4PID14_OxySensor1_Volt S22F4PID 20-20;
SG_MUL_VAL_ 2564485397 S22F4PID15_OxySensor2_STFT S22F4PID 21-21;
SG_MUL_VAL_ 2564485397 S22F4PID15_OxySensor2_Volt S22F4PID 21-21;
SG_MUL_VAL_ 2564485397 S22F4PID16_OxySensor3_STFT S22F4PID 22-22;
SG_MUL_VAL_ 2564485397 S22F4PID16_OxySensor3_Volt S22F4PID 22-22;
SG_MUL_VAL_ 2564485397 S22F4PID17_OxySensor4_STFT S22F4PID 23-23;
SG_MUL_VAL_ 2564485397 S22F4PID17_OxySensor4_Volt S22F4PID 23-23;
SG_MUL_VAL_ 2564485397 S22F4PID18_OxySensor5_STFT S22F4PID 24-24;
SG_MUL_VAL_ 2564485397 S22F4PID18_OxySensor5_Volt S22F4PID 24-24;
SG_MUL_VAL_ 2564485397 S22F4PID19_OxySensor6_STFT S22F4PID 25-25;
SG_MUL_VAL_ 2564485397 S22F4PID19_OxySensor6_Volt S22F4PID 25-25;
SG_MUL_VAL_ 2564485397 S22F4PID1A_OxySensor7_STFT S22F4PID 26-26;
SG_MUL_VAL_ 2564485397 S22F4PID1A_OxySensor7_Volt S22F4PID 26-26;
SG_MUL_VAL_ 2564485397 S22F4PID1B_OxySensor8_STFT S22F4PID 27-27;
SG_MUL_VAL_ 2564485397 S22F4PID1B_OxySensor8_Volt S22F4PID 27-27;
SG_MUL_VAL_ 2564485397 S22F4PID1C_OBDStandard S22F4PID 28-28;
SG_MUL_VAL_ 2564485397 S22F4PID1F_TimeSinceEngStart S22F4PID 31-31;
SG_MUL_VAL_ 2564485397 S22F4PID20_PIDsSupported_21_40 S22F4PID 32-32;
SG_MUL_VAL_ 2564485397 S22F4PID21_DistanceMILOn S22F4PID 33-33;
SG_MUL_VAL_ 2564485397 S22F4PID22_FuelRailPres S22F4PID 34-34;
SG_MUL_VAL_ 2564485397 S22F4PID23_FuelRailGaug S22F4PID 35-35;
SG_MUL_VAL_ 2564485397 S22F4PID24_OxySensor1_FAER S22F4PID 36-36;
SG_MUL_VAL_ 2564485397 S22F4PID24_OxySensor1_Volt S22F4PID 36-36;
SG_MUL_VAL_ 2564485397 S22F4PID25_OxySensor2_FAER S22F4PID 37-37;
SG_MUL_VAL_ 2564485397 S22F4PID25_OxySensor2_Volt S22F4PID 37-37;
SG_MUL_VAL_ 2564485397 S22F4PID26_OxySensor3_FAER S22F4PID 38-38;
SG_MUL_VAL_ 2564485397 S22F4PID26_OxySensor3_Volt S22F4PID 38-38;
SG_MUL_VAL_ 2564485397 S22F4PID27_OxySensor4_FAER S22F4PID 39-39;
SG_MUL_VAL_ 2564485397 S22F4PID27_OxySensor4_Volt S22F4PID 39-39;
SG_MUL_VAL_ 2564485397 S22F4PID28_OxySensor5_FAER S22F4PID 40-40;
SG_MUL_VAL_ 2564485397 S22F4PID28_OxySensor5_Volt S22F4PID 40-40;
SG_MUL_VAL_ 2564485397 S22F4PID29_OxySensor6_FAER S22F4PID 41-41;
SG_MUL_VAL_ 2564485397 S22F4PID29_OxySensor6_Volt S22F4PID 41-41;
SG_MUL_VAL_ 2564485397 S22F4PID2A_OxySensor7_FAER S22F4PID 42-42;
SG_MUL_VAL_ 2564485397 S22F4PID2A_OxySensor7_Volt S22F4PID 42-42;
SG_MUL_VAL_ 2564485397 S22F4PID2B_OxySensor8_FAER S22F4PID 43-43;
SG_MUL_VAL_ 2564485397 S22F4PID2B_OxySensor8_Volt S22F4PID 43-43;
SG_MUL_VAL_ 2564485397 S22F4PID2C_CmdEGR S22F4PID 44-44;
SG_MUL_VAL_ 2564485397 S22F4PID2D_EGRError S22F4PID 45-45;
SG_MUL_VAL_ 2564485397 S22F4PID2E_CmdEvapPurge S22F4PID 46-46;
SG_MUL_VAL_ 2564485397 S22F4PID2F_FuelTankLevel S22F4PID 47-47;
SG_MUL_VAL_ 2564485397 S22F4PID30_WarmUpsSinceCodeClear S22F4PID 48-48;
SG_MUL_VAL_ 2564485397 S22F4PID31_DistanceSinceCodeClear S22F4PID 49-49;
SG_MUL_VAL_ 2564485397 S22F4PID32_EvapSysVaporPres S22F4PID 50-50;
SG_MUL_VAL_ 2564485397 S22F4PID33_AbsBaroPres S22F4PID 51-51;
SG_MUL_VAL_ 2564485397 S22F4PID34_OxySensor1_Crnt S22F4PID 52-52;
SG_MUL_VAL_ 2564485397 S22F4PID34_OxySensor1_FAER S22F4PID 52-52;
SG_MUL_VAL_ 2564485397 S22F4PID35_OxySensor2_Crnt S22F4PID 53-53;
SG_MUL_VAL_ 2564485397 S22F4PID35_OxySensor2_FAER S22F4PID 53-53;
SG_MUL_VAL_ 2564485397 S22F4PID36_OxySensor3_Crnt S22F4PID 54-54;
SG_MUL_VAL_ 2564485397 S22F4PID36_OxySensor3_FAER S22F4PID 54-54;
SG_MUL_VAL_ 2564485397 S22F4PID37_OxySensor4_Crnt S22F4PID 55-55;
SG_MUL_VAL_ 2564485397 S22F4PID37_OxySensor4_FAER S22F4PID 55-55;
SG_MUL_VAL_ 2564485397 S22F4PID38_OxySensor5_Crnt S22F4PID 56-56;
SG_MUL_VAL_ 2564485397 S22F4PID38_OxySensor5_FAER S22F4PID 56-56;
SG_MUL_VAL_ 2564485397 S22F4PID39_OxySensor6_Crnt S22F4PID 57-57;
SG_MUL_VAL_ 2564485397 S22F4PID39_OxySensor6_FAER S22F4PID 57-57;
SG_MUL_VAL_ 2564485397 S22F4PID3A_OxySensor7_Crnt S22F4PID 58-58;
SG_MUL_VAL_ 2564485397 S22F4PID3A_OxySensor7_FAER S22F4PID 58-58;
SG_MUL_VAL_ 2564485397 S22F4PID3B_OxySensor8_Crnt S22F4PID 59-59;
SG_MUL_VAL_ 2564485397 S22F4PID3B_OxySensor8_FAER S22F4PID 59-59;
SG_MUL_VAL_ 2564485397 S22F4PID3C_CatTempBank1Sens1 S22F4PID 60-60;
SG_MUL_VAL_ 2564485397 S22F4PID3D_CatTempBank2Sens1 S22F4PID 61-61;
SG_MUL_VAL_ 2564485397 S22F4PID3E_CatTempBank1Sens2 S22F4PID 62-62;
SG_MUL_VAL_ 2564485397 S22F4PID3F_CatTempBank2Sens2 S22F4PID 63-63;
SG_MUL_VAL_ 2564485397 S22F4PID40_PIDsSupported_41_60 S22F4PID 64-64;
SG_MUL_VAL_ 2564485397 S22F4PID41_MonStatusDriveCycle S22F4PID 65-65;
SG_MUL_VAL_ 2564485397 S22F4PID42_ControlModuleVolt S22F4PID 66-66;
SG_MUL_VAL_ 2564485397 S22F4PID43_AbsLoadValue S22F4PID 67-67;
SG_MUL_VAL_ 2564485397 S22F4PID44_FuelAirCmdEquiv S22F4PID 68-68;
SG_MUL_VAL_ 2564485397 S22F4PID45_RelThrottlePos S22F4PID 69-69;
SG_MUL_VAL_ 2564485397 S22F4PID46_AmbientAirTemp S22F4PID 70-70;
SG_MUL_VAL_ 2564485397 S22F4PID47_AbsThrottlePosB S22F4PID 71-71;
SG_MUL_VAL_ 2564485397 S22F4PID48_AbsThrottlePosC S22F4PID 72-72;
SG_MUL_VAL_ 2564485397 S22F4PID49_AbsThrottlePosD S22F4PID 73-73;
SG_MUL_VAL_ 2564485397 S22F4PID4A_AbsThrottlePosE S22F4PID 74-74;
SG_MUL_VAL_ 2564485397 S22F4PID4B_AbsThrottlePosF S22F4PID 75-75;
SG_MUL_VAL_ 2564485397 S22F4PID4C_CmdThrottleAct S22F4PID 76-76;
SG_MUL_VAL_ 2564485397 S22F4PID4D_TimeRunMILOn S22F4PID 77-77;
SG_MUL_VAL_ 2564485397 S22F4PID4E_TimeSinceCodeClear S22F4PID 78-78;
SG_MUL_VAL_ 2564485397 S22F4PID4F_Max_FAER S22F4PID 79-79;
SG_MUL_VAL_ 2564485397 S22F4PID4F_Max_IntManiAbsPres S22F4PID 79-79;
SG_MUL_VAL_ 2564485397 S22F4PID4F_Max_OxySensCrnt S22F4PID 79-79;
SG_MUL_VAL_ 2564485397 S22F4PID4F_Max_OxySensVol S22F4PID 79-79;
SG_MUL_VAL_ 2564485397 S22F4PID50_Max_AirFlowMAF S22F4PID 80-80;
SG_MUL_VAL_ 2564485397 S22F4PID51_FuelType S22F4PID 81-81;
SG_MUL_VAL_ 2564485397 S22F4PID52_EthanolFuelPct S22F4PID 82-82;
SG_MUL_VAL_ 2564485397 S22F4PID53_AbsEvapSysVapPres S22F4PID 83-83;
SG_MUL_VAL_ 2564485397 S22F4PID54_EvapSysVapPres S22F4PID 84-84;
SG_MUL_VAL_ 2564485397 S22F4PID55_ShortSecOxyTrimBank1 S22F4PID 85-85;
SG_MUL_VAL_ 2564485397 S22F4PID55_ShortSecOxyTrimBank3 S22F4PID 85-85;
SG_MUL_VAL_ 2564485397 S22F4PID56_LongSecOxyTrimBank1 S22F4PID 86-86;
SG_MUL_VAL_ 2564485397 S22F4PID56_LongSecOxyTrimBank3 S22F4PID 86-86;
SG_MUL_VAL_ 2564485397 S22F4PID57_ShortSecOxyTrimBank2 S22F4PID 87-87;
SG_MUL_VAL_ 2564485397 S22F4PID57_ShortSecOxyTrimBank4 S22F4PID 87-87;
SG_MUL_VAL_ 2564485397 S22F4PID58_LongSecOxyTrimBank2 S22F4PID 88-88;
SG_MUL_VAL_ 2564485397 S22F4PID58_LongSecOxyTrimBank4 S22F4PID 88-88;
SG_MUL_VAL_ 2564485397 S22F4PID59_FuelRailAbsPres S22F4PID 89-89;
SG_MUL_VAL_ 2564485397 S22F4PID5A_RelAccelPedalPos S22F4PID 90-90;
SG_MUL_VAL_ 2564485397 S22F4PID5B_HybrBatPackRemLife S22F4PID 91-91;
SG_MUL_VAL_ 2564485397 S22F4PID5C_EngineOilTemp S22F4PID 92-92;
SG_MUL_VAL_ 2564485397 S22F4PID5D_FuelInjectionTiming S22F4PID 93-93;
SG_MUL_VAL_ 2564485397 S22F4PID5E_EngineFuelRate S22F4PID 94-94;
SG_MUL_VAL_ 2564485397 S22F4PID5F_EmissionReq S22F4PID 95-95;
SG_MUL_VAL_ 2564485397 S22F4PID60_PIDsSupported_61_80 S22F4PID 96-96;
SG_MUL_VAL_ 2564485397 S22F4PID61_DemandEngTorqPct S22F4PID 97-97;
SG_MUL_VAL_ 2564485397 S22F4PID62_ActualEngTorqPct S22F4PID 98-98;
SG_MUL_VAL_ 2564485397 S22F4PID63_EngRefTorq S22F4PID 99-99;
SG_MUL_VAL_ 2564485397 S22F4PID65_AuxInputOutput S22F4PID 101-101;
SG_MUL_VAL_ 2564485397 S22F4PID66_MAFSensor S22F4PID 102-102;
SG_MUL_VAL_ 2564485397 S22F4PID67_EngineCoolantTemp S22F4PID 103-103;
SG_MUL_VAL_ 2564485397 S22F4PID68_IntakeAirTempSens S22F4PID 104-104;
SG_MUL_VAL_ 2564485397 S22F4PID69_CmdEGR_EGRError S22F4PID 105-105;
SG_MUL_VAL_ 2564485397 S22F4PID6A_CmdDieselIntAir S22F4PID 106-106;
SG_MUL_VAL_ 2564485397 S22F4PID6B_ExhaustGasTemp S22F4PID 107-107;
SG_MUL_VAL_ 2564485397 S22F4PID6C_CmdThrottleActRel S22F4PID 108-108;
SG_MUL_VAL_ 2564485397 S22F4PID6D_FuelPresContrSys S22F4PID 109-109;
SG_MUL_VAL_ 2564485397 S22F4PID6E_InjPresContrSys S22F4PID 110-110;
SG_MUL_VAL_ 2564485397 S22F4PID6F_TurboComprPres S22F4PID 111-111;
SG_MUL_VAL_ 2564485397 S22F4PID70_BoostPresCntrl S22F4PID 112-112;
SG_MUL_VAL_ 2564485397 S22F4PID80_PIDsSupported_81_A0 S22F4PID 128-128;
SG_MUL_VAL_ 2564485397 S22F4PID8E_EngFrictionPctTorq S22F4PID 142-142;
SG_MUL_VAL_ 2564485397 S22F4PIDA0_PIDsSupported_A1_C0 S22F4PID 160-160;
SG_MUL_VAL_ 2564485397 S22F4PIDA6_Odometer S22F4PID 166-166;
SG_MUL_VAL_ 2564485397 S22F4PIDC0_PIDsSupported_C1_E0 S22F4PID 192-192;
SG_MUL_VAL_ 2564485397 S22F8PID SubFct 248-248;
SG_MUL_VAL_ 2564485397 SubFct S 98-98;
